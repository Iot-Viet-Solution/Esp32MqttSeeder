## main/Kconfig.projbuild
```kconfig
menu "Esp32 MQTT Seeder Configuration"

    menu "WiFi Settings"
        config SEEDER_WIFI_SSID
            string "WiFi SSID"
            default "MyWiFi"
            help
                SSID of the WiFi network to connect to.

        config SEEDER_WIFI_PASSWORD
            string "WiFi Password"
            default "password"
            help
                Password of the WiFi network. Leave empty for open networks.

        config SEEDER_WIFI_MAX_RETRY
            int "Maximum WiFi reconnect retries"
            default 5
            range 1 20
            help
                Number of times to retry a WiFi connection before giving up.
    endmenu

    menu "MQTT Broker Settings"
        config SEEDER_MQTT_BROKER_URI
            string "MQTT Broker URI"
            default "mqtts://192.168.1.100:8883"
            help
                Full URI of the MQTT5 broker (e.g. mqtt://broker.example.com:1883).
                For TLS connections use mqtts:// (e.g. mqtts://broker.example.com:8883).

        config SEEDER_MQTT_USERNAME
            string "MQTT Username"
            default ""
            help
                Username for broker authentication. Leave empty if not required.

        config SEEDER_MQTT_PASSWORD
            string "MQTT Password"
            default ""
            help
                Password for broker authentication. Leave empty if not required.

        config SEEDER_MQTT_KEEPALIVE_SEC
            int "MQTT keepalive interval (seconds)"
            default 60
            range 10 3600
            help
                MQTT keepalive interval in seconds.

        menu "TLS / Certificate Settings"
            config SEEDER_MQTT_TLS_ENABLED
                bool "Enable TLS for MQTT connection"
                default y
                help
                    Enable TLS/SSL encryption for the MQTT connection.
                    The broker URI must use the mqtts:// scheme when this is enabled.
                    Certificate files are embedded into the firmware at build time
                    from the project-root certs/ directory.

            choice SEEDER_MQTT_TLS_VERIFY_MODE
                prompt "Broker certificate verification mode"
                depends on SEEDER_MQTT_TLS_ENABLED
                default SEEDER_MQTT_TLS_VERIFY_CA
                help
                    Select how the MQTT broker certificate is verified.

            config SEEDER_MQTT_TLS_VERIFY_CA
                bool "Verify broker using CA certificate"
                help
                    Embed the CA certificate used to verify the broker's TLS certificate.
                    Place the PEM-encoded certificate at certs/mqtt_ca.crt before building.

            config SEEDER_MQTT_TLS_VERIFY_THUMBPRINT
                bool "Verify broker using pinned broker cert (thumbprint-style)"
                help
                    Embed the broker leaf certificate at certs/mqtt_broker.crt and
                    verify TLS against that exact certificate.
                    This behaves like certificate pinning and can be used as a
                    thumbprint-style verification alternative to CA trust.

            config SEEDER_MQTT_TLS_VERIFY_INSECURE
                bool "Skip broker certificate verification (insecure)"
                help
                    Do not verify the broker certificate. This is for local testing only
                    and is not recommended for production.
            endchoice

            config SEEDER_MQTT_CLIENT_CERT
                bool "Embed client certificate and key (mutual TLS)"
                depends on SEEDER_MQTT_TLS_ENABLED
                default n
                help
                    Embed a client certificate and private key for mutual TLS (mTLS)
                    authentication.  Place the PEM-encoded files at:
                      certs/mqtt_client.crt  – client certificate
                      certs/mqtt_client.key  – client private key
                    These files must be present before building.
        endmenu
    endmenu

    menu "Device Identity"
        config SEEDER_DEVICE_ID
            string "Device ID (string wildcard)"
            default "DEV-001"
            help
                Device identifier used as the string wildcard in:
                - uplink/heartbeat/v1/<device_id>
                - devices/<device_id>/log/<level>

        config SEEDER_DEVICE_TYPE
            string "Device Type"
            default "seeder"
            help
                Device type string sent in the devices/init payload when the
                device connects to the broker for the first time or after a
                restart.

        config SEEDER_ATTRIBUTE_NAME
            string "Attribute name"
            default "temperature"
            help
                Attribute name included in the heartbeat payload.

        config SEEDER_DEVICE_STATUS
            string "Device status"
            default "online"
            help
                Device status string included in the heartbeat payload.
    endmenu

    menu "Heartbeat Publisher"
        config SEEDER_HEARTBEAT_INTERVAL_MS
            int "Heartbeat publish interval (ms)"
            default 5000
            range 500 3600000
            help
                Interval between heartbeat publishes in milliseconds.
    endmenu

    menu "Counter Publisher"
        config SEEDER_COUNTER_ID
            int "Counter ID (number wildcard)"
            default 1
            range 0 65535
            help
                Numeric identifier used as the wildcard in uplink/v3/di/<counter_id>.

        config SEEDER_COUNTER_INTERVAL_MS
            int "Counter publish interval (ms)"
            default 1000
            range 100 3600000
            help
                Interval between counter publishes in milliseconds.

        config SEEDER_COUNTER_RESET_HOUR
            int "Counter reset hour (0-23, 255 = disabled)"
            default 255
            range 0 255
            help
                UTC hour of day (0-23) at which shoot_count is automatically
                reset to zero.  Set to 255 to disable the scheduled reset.
                The reset fires once per hour at the first publish after the
                configured hour begins.
    endmenu

    menu "Log Publisher"
        config SEEDER_LOG_LEVEL
            string "Log level"
            default "info"
            help
                Log level string for the log topic: devices/<id>/log/<level>.
                Valid values: verbose, debug, info, warning, error, fatal, none.

        config SEEDER_LOG_INTERVAL_MS
            int "Log publish interval (ms)"
            default 10000
            range 500 3600000
            help
                Interval between log publishes in milliseconds.
    endmenu

endmenu
```

## sdkconfig.defaults
```kconfig
# Enable MQTT5 protocol support
CONFIG_MQTT_PROTOCOL_5=y

# Use larger main task stack (publishers spawn their own tasks)
CONFIG_ESP_MAIN_TASK_STACK_SIZE=8192

# Enable SNTP for NTP time sync
CONFIG_LWIP_DHCP_GET_NTP_SRV=y

# Increase FreeRTOS tick rate for finer timer resolution
CONFIG_FREERTOS_HZ=1000

# Set log level
CONFIG_LOG_DEFAULT_LEVEL_INFO=y

# Default to one-way TLS for MQTT (server verification only)
CONFIG_SEEDER_MQTT_BROKER_URI="mqtts://192.168.1.100:8883"
CONFIG_SEEDER_MQTT_TLS_ENABLED=y
CONFIG_SEEDER_MQTT_TLS_VERIFY_CA=y
# Keep mutual TLS optional
# CONFIG_SEEDER_MQTT_CLIENT_CERT is not set

# Partition table – single-app with larger OTA partition
CONFIG_PARTITION_TABLE_SINGLE_APP_LARGE=y
```
